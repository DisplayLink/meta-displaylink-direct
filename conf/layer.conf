## conf/layer.conf
```bitbake
BBPATH .= ":${LAYERDIR}"

BBFILES += " \
    ${LAYERDIR}/recipes-dlsdk/libdlsdk/*.bb \
    ${LAYERDIR}/recipes-dlsdk/dlsdk-samples-basic/*.bb \
    ${LAYERDIR}/recipes-dlsdk/python3-dlsdk/*.bb \
"

BBFILES_DYNAMIC += " \
    multimedia-layer:${LAYERDIR}/recipes-dlsdk/dlsdk-samples-video/*.bb \
    qt6-layer:${LAYERDIR}/recipes-dlsdk/dlsdk-qt-plugin/*.bb \
    meta-python:${LAYERDIR}/recipes-dlsdk/python3-dlsdk-samples/*.bb \
    meta-python:${LAYERDIR}/recipes-python/python3-pysdl2/*.bb \
"

BBFILE_COLLECTIONS += "displaylink-direct"
BBFILE_PATTERN_displaylink-direct = "^${LAYERDIR}/"
BBFILE_PRIORITY_displaylink-direct = "6"

LAYERDEPENDS_displaylink-direct = "core"
LAYERSERIES_COMPAT_displaylink-direct = "scarthgap wrynose"

# Debian 13 build host is not validated on Scarthgap, but seems to work fine
SANITY_TESTED_DISTROS:append = " debian-13"
```

## kas/uno-q/meta-custom/conf/layer.conf
```bitbake
BBPATH .= ":${LAYERDIR}"

BBFILES += "${LAYERDIR}/recipes-*/*/*.bb ${LAYERDIR}/recipes-*/*/*.bbappend"

BBFILE_COLLECTIONS += "meta-custom"
BBFILE_PATTERN_meta-custom = "^${LAYERDIR}/"
BBFILE_PRIORITY_meta-custom = "7"

LAYERDEPENDS_meta-custom = "core qcom-3rdparty"
LAYERSERIES_COMPAT_meta-custom = "wrynose"
```
